## package/Config.in
```kconfig
source "$BR2_EXTERNAL_BOUFFALO_BR_PATH/package/cloudutils/Config.in"
source "$BR2_EXTERNAL_BOUFFALO_BR_PATH/package/blwnet_xram/Config.in"
source "$BR2_EXTERNAL_BOUFFALO_BR_PATH/package/i2c-bl808/Config.in"
```
